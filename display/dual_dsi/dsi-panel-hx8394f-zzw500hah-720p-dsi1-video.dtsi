/*
 * Copyright (c) 2015-2016, The Linux Foundation. All rights reserved.
 *
 * This program is free software; you can redistribute it and/or modify
 * it under the terms of the GNU General Public License version 2 and
 * only version 2 as published by the Free Software Foundation.
 *
 * This program is distributed in the hope that it will be useful,
 * but WITHOUT ANY WARRANTY; without even the implied warranty of
 * MERCHANTABILITY or FITNESS FOR A PARTICULAR PURPOSE.  See the
 * GNU General Public License for more details.
 */

/*---------------------------------------------------------------------------
 * This file is autogenerated file using gcdb parser. Please do not edit it.
 * Update input XML file to add a new entry or update variable in this file
 * VERSION = "1.0"
 *---------------------------------------------------------------------------*/
&mdss_mdp {
	dsi_hx8394f_zzw500hah_720p_dsi1_video: qcom,mdss_dsi_hx8394f_zzw500hah_720p_dsi1_video {
		qcom,mdss-dsi-panel-name = "hx8394f zzw500hah hd 720X1280 dsi1 video mode dsi panel";
		qcom,mdss-dsi-panel-type = "dsi_video_mode";
		qcom,mdss-dsi-panel-framerate = <60>;
		qcom,mdss-dsi-virtual-channel-id = <0>;
		qcom,mdss-dsi-stream = <0>;
		qcom,mdss-dsi-panel-width = <720>;
		qcom,mdss-dsi-panel-height = <1280>;
		qcom,mdss-dsi-h-front-porch = <70>;
		qcom,mdss-dsi-h-back-porch = <70>;
		qcom,mdss-dsi-h-pulse-width = <20>;
		qcom,mdss-dsi-h-sync-skew = <0>;
		qcom,mdss-dsi-v-back-porch = <12>;
		qcom,mdss-dsi-v-front-porch = <15>;
		qcom,mdss-dsi-v-pulse-width = <4>;
		qcom,mdss-dsi-h-left-border = <0>;
		qcom,mdss-dsi-h-right-border = <0>;
		qcom,mdss-dsi-v-top-border = <0>;
		qcom,mdss-dsi-v-bottom-border = <0>;
		qcom,mdss-dsi-bpp = <24>;
		qcom,mdss-dsi-color-order = "rgb_swap_rgb";
		qcom,mdss-dsi-underflow-color = <0xff>;
		qcom,mdss-dsi-border-color = <0>;
		qcom,mdss-dsi-pixel-packing = "tight";
		qcom,mdss-dsi-pixel-alignment = <0>;
		qcom,mdss-dsi-on-command = [39 01 00 00 00 00 04 B9 FF 83 94
					39 01 00 00 00 00 07 BA 63 03 68 6B B2 C0
				    39 01 00 00 00 00 0B B1 48 11 71 09 32 54 71 71 4E 43
					39 01 00 00 00 00 07 B2 65 80 64 05 07 2F
					39 01 00 00 00 00 16 B4 26 76 26 76 26 26 05 10 86 75 00 3F 26 76 26 76 26 26 05 10 80
					39 01 00 00 00 00 22 D3 00 00 04 04 01 01 10 10 32 10 00 00 00 32 15 04 05 04 32 15 14 05 14 37 33 04 04 37 00 00 47 05 40
					39 01 00 00 00 00 2D D5 18 18 18 18 18 18 18 18 18 18 18 18 18 18 25 24 27 26 18 18 11 10 15 14 13 12 17 16 01 00 05 04 03 02 07 06 21 20 23 22 18 18 18 18
					39 01 00 00 00 00 2D D6 18 18 18 18 18 18 18 18 18 18 18 18 18 18 22 23 20 21 18 18 12 13 16 17 10 11 14 15 06 07 02 03 04 05 00 01 26 27 24 25 18 18 18 18
					39 01 00 00 00 00 3B E0 00 04 11 1B 1E 22 27 26 51 60 70 6F 7A 8C 94 9A A9 AC A9 B9 C8 64 62 67 69 6A 7F 7F 7F 00 04 11 1A 1D 22 27 26 51 60 70 6F 79 8C 93 98 A8 AB AA B7 C8 64 63 67 6D 72 7F 7F 7F
					39 01 00 00 00 00 03 B6 7D 7D
					39 01 00 00 00 00 02 CC 0B
					39 01 00 00 00 00 03 C0 1F 31
					39 01 00 00 00 00 02 D2 88
					39 01 00 00 00 00 02 D4 02
					39 01 00 00 00 00 02 BD 01
					39 01 00 00 00 00 02 B1 00
					39 01 00 00 00 00 02 BD 00
					39 01 00 00 00 00 08 BF 40 81 50 00 1A FC 01
					39 01 00 00 00 00 02 C6 EF					
					05 01 00 00 78 00 02 11 00
					05 01 00 00 14 00 02 29 00];
		qcom,mdss-dsi-off-command = [05 01 00 00 32 00 02 28 00
					05 01 00 00 78 00 02 10 00];
		qcom,mdss-dsi-on-command-state = "dsi_lp_mode";
		qcom,mdss-dsi-off-command-state = "dsi_hs_mode";
		qcom,mdss-dsi-h-sync-pulse = <1>;
		qcom,mdss-dsi-traffic-mode = "burst_mode";
		qcom,mdss-dsi-lane-map = "lane_map_0123";
		qcom,mdss-dsi-bllp-eof-power-mode;
		qcom,mdss-dsi-bllp-power-mode;
		qcom,mdss-dsi-lane-0-state;
		qcom,mdss-dsi-lane-1-state;
		qcom,mdss-dsi-lane-2-state;
		qcom,mdss-dsi-lane-3-state;
		qcom,mdss-dsi-panel-timings = [7B 1A 10 00 3E 40 16 1C 15 03 04 00];
		qcom,mdss-dsi-panel-timings-8996 = [1c 19 02 03 01 03 04 a0
			1c 19 02 03 01 03 04 a0
			1c 19 02 03 01 03 04 a0
			1c 19 02 03 01 03 04 a0
			1c 08 02 03 01 03 04 a0];

		qcom,mdss-dsi-t-clk-post = <0x04>;
		qcom,mdss-dsi-t-clk-pre = <0x26>;
		qcom,mdss-dsi-bl-min-level = <1>;
		qcom,mdss-dsi-bl-max-level = <4095>;
		qcom,mdss-dsi-dma-trigger = "trigger_sw";
		qcom,mdss-dsi-mdp-trigger = "none";
		qcom,mdss-dsi-reset-sequence = <1 20>, <0 50>, <1 120>;
		qcom,dba-panel;
		qcom,bridge-name = "fake-dba";
		qcom,display-id = "secondary";
		qcom,dsi-resolution = "1280x720p60@zzw500hah";
	};
};
