/* Copyright (c) 2013, The Linux Foundation. All rights reserved.
 *
 * This program is free software; you can redistribute it and/or modify
 * it under the terms of the GNU General Public License version 2 and
 * only version 2 as published by the Free Software Foundation.
 *
 * This program is distributed in the hope that it will be useful,
 * but WITHOUT ANY WARRANTY; without even the implied warranty of
 * MERCHANTABILITY or FITNESS FOR A PARTICULAR PURPOSE.  See the
 * GNU General Public License for more details.
 */

/*---------------------------------------------------------------------------
 * This file is autogenerated file using gcdb parser. Please do not edit it.
 * Update input XML file to add a new entry or update variable in this file
 * VERSION = "1.0"
 *---------------------------------------------------------------------------*/
&mdss_mdp {
	dsi_nt35532_jm55fh_1080p_video: qcom,mdss_dsi_nt35532_jm55fh_1080p_video {
		qcom,mdss-dsi-panel-name = "nt35532 jm55fh 1080p video mode dsi panel";
		qcom,mdss-dsi-panel-controller = <&mdss_dsi0>;
		qcom,mdss-dsi-panel-type = "dsi_video_mode";
		qcom,mdss-dsi-panel-destination = "display_1";
		qcom,mdss-dsi-panel-framerate = <60>;
		qcom,mdss-dsi-virtual-channel-id = <0>;
		qcom,mdss-dsi-stream = <0>;
		qcom,mdss-dsi-panel-width = <1080>;
		qcom,mdss-dsi-panel-height = <1920>;
		qcom,mdss-dsi-h-front-porch = <32>;
		qcom,mdss-dsi-h-back-porch = <32>;
		qcom,mdss-dsi-h-pulse-width = <8>;
		qcom,mdss-dsi-h-sync-skew = <0>;
		qcom,mdss-dsi-v-back-porch = <3>;
		qcom,mdss-dsi-v-front-porch = <6>;
		qcom,mdss-dsi-v-pulse-width = <2>;
		qcom,mdss-dsi-h-left-border = <0>;
		qcom,mdss-dsi-h-right-border = <0>;
		qcom,mdss-dsi-v-top-border = <0>;
		qcom,mdss-dsi-v-bottom-border = <0>;
		qcom,mdss-dsi-bpp = <24>;
		qcom,mdss-dsi-color-order = "rgb_swap_rgb";
		qcom,mdss-dsi-underflow-color = <0xff>;
		qcom,mdss-dsi-border-color = <0>;
		qcom,mdss-dsi-on-command = [29 01 00 00 00 00 02 FF 01 
					29 01 00 00 00 00 02 6E 80 
					29 01 00 00 00 00 02 68 13 
					29 01 00 00 00 00 02 FB 01 
					29 01 00 00 00 00 02 FF 02 
					29 01 00 00 00 00 02 FB 01 
					29 01 00 00 00 00 02 FF 05 
					29 01 00 00 00 00 02 FB 01 
					29 01 00 00 00 00 02 D7 31 
					29 01 00 00 64 00 02 D8 7E 
					29 01 00 00 00 00 02 FF 00 
					29 01 00 00 00 00 02 FB 01 
					29 01 00 00 00 00 02 BA 03 
					29 01 00 00 00 00 02 35 00 
					29 01 00 00 00 00 02 36 00 
					29 01 00 00 00 00 02 B0 00 
					29 01 00 00 00 00 02 D3 0A 
					29 01 00 00 00 00 02 D4 0F 
					29 01 00 00 00 00 02 D5 0F 
					29 01 00 00 00 00 02 D6 48 
					29 01 00 00 00 00 02 D7 00 
					29 01 00 00 00 00 02 D9 00 
					29 01 00 00 00 00 02 FF EE 
					29 01 00 00 00 00 02 02 00 
					29 01 00 00 00 00 02 40 00 
					29 01 00 00 00 00 02 02 00 
					29 01 00 00 00 00 02 41 00 
					29 01 00 00 00 00 02 02 00 
					29 01 00 00 00 00 02 42 00 
					29 01 00 00 00 00 02 FB 01 
					29 01 00 00 00 00 02 FF 01 
					29 01 00 00 00 00 02 FB 01 
					29 01 00 00 00 00 02 01 55 
					29 01 00 00 00 00 02 04 0C 
					29 01 00 00 00 00 02 05 3A 
					29 01 00 00 00 00 02 06 50 
					29 01 00 00 00 00 02 07 D0 
					29 01 00 00 00 00 02 0A 0F 
					29 01 00 00 00 00 02 0C 06 
					29 01 00 00 00 00 02 0D 6B 
					29 01 00 00 00 00 02 0E 6B 
					29 01 00 00 00 00 02 0F 70 
					29 01 00 00 00 00 02 10 63 
					29 01 00 00 00 00 02 11 3C 
					29 01 00 00 00 00 02 12 5C 
					29 01 00 00 00 00 02 13 30 
					29 01 00 00 00 00 02 14 30 
					29 01 00 00 00 00 02 15 60 
					29 01 00 00 00 00 02 16 15 
					29 01 00 00 00 00 02 17 15 
					29 01 00 00 00 00 02 23 01 
					29 01 00 00 00 00 02 24 01 
					29 01 00 00 00 00 02 25 01 
					29 01 00 00 00 00 02 26 01 
					29 01 00 00 00 00 02 27 01 
					29 01 00 00 00 00 02 28 01 
					29 01 00 00 00 00 02 44 01 
					29 01 00 00 00 00 02 45 01 
					29 01 00 00 00 00 02 46 01 
					29 01 00 00 00 00 02 5B CA 
					29 01 00 00 00 00 02 5C 00 
					29 01 00 00 00 00 02 5D 00 
					29 01 00 00 00 00 02 5E 15 
					29 01 00 00 00 00 02 5F 1B 
					29 01 00 00 00 00 02 60 D5 
					29 01 00 00 00 00 02 61 F0 
					29 01 00 00 00 00 02 6C AB 
					29 01 00 00 00 00 02 6D 44 
					29 01 00 00 00 00 02 6E 80 
					29 01 00 00 00 00 02 FF 05 
					29 01 00 00 00 00 02 FB 01 
					29 01 00 00 00 00 02 00 3F 
					29 01 00 00 00 00 02 01 3F 
					29 01 00 00 00 00 02 02 3F 
					29 01 00 00 00 00 02 03 3F 
					29 01 00 00 00 00 02 04 38 
					29 01 00 00 00 00 02 05 3F 
					29 01 00 00 00 00 02 06 3F 
					29 01 00 00 00 00 02 07 19 
					29 01 00 00 00 00 02 08 1B 
					29 01 00 00 00 00 02 09 3F 
					29 01 00 00 00 00 02 0A 1D 
					29 01 00 00 00 00 02 0B 17 
					29 01 00 00 00 00 02 0C 3F 
					29 01 00 00 00 00 02 0D 02 
					29 01 00 00 00 00 02 0E 08 
					29 01 00 00 00 00 02 0F 0C 
					29 01 00 00 00 00 02 10 3F 
					29 01 00 00 00 00 02 11 10 
					29 01 00 00 00 00 02 12 3F 
					29 01 00 00 00 00 02 13 3F 
					29 01 00 00 00 00 02 14 3F 
					29 01 00 00 00 00 02 15 3F 
					29 01 00 00 00 00 02 16 3F 
					29 01 00 00 00 00 02 17 3F 
					29 01 00 00 00 00 02 18 38 
					29 01 00 00 00 00 02 19 18 
					29 01 00 00 00 00 02 1A 1A 
					29 01 00 00 00 00 02 1B 3F 
					29 01 00 00 00 00 02 1C 3F 
					29 01 00 00 00 00 02 1D 1C 
					29 01 00 00 00 00 02 1E 16 
					29 01 00 00 00 00 02 1F 3F 
					29 01 00 00 00 00 02 20 3F 
					29 01 00 00 00 00 02 21 02 
					29 01 00 00 00 00 02 22 06 
					29 01 00 00 00 00 02 23 0A 
					29 01 00 00 00 00 02 24 3F 
					29 01 00 00 00 00 02 25 0E 
					29 01 00 00 00 00 02 26 3F 
					29 01 00 00 00 00 02 27 3F 
					29 01 00 00 00 00 02 54 08 
					29 01 00 00 00 00 02 55 07 
					29 01 00 00 00 00 02 56 1A 
					29 01 00 00 00 00 02 58 19 
					29 01 00 00 00 00 02 59 36 
					29 01 00 00 00 00 02 5A 1B 
					29 01 00 00 00 00 02 5B 01 
					29 01 00 00 00 00 02 5C 32 
					29 01 00 00 00 00 02 5E 27 
					29 01 00 00 00 00 02 5F 28 
					29 01 00 00 00 00 02 60 2B 
					29 01 00 00 00 00 02 61 2C 
					29 01 00 00 00 00 02 62 18 
					29 01 00 00 00 00 02 63 01 
					29 01 00 00 00 00 02 64 32 
					29 01 00 00 00 00 02 65 00 
					29 01 00 00 00 00 02 66 44 
					29 01 00 00 00 00 02 67 11 
					29 01 00 00 00 00 02 68 01 
					29 01 00 00 00 00 02 69 01 
					29 01 00 00 00 00 02 6A 06 
					29 01 00 00 00 00 02 6B 22 
					29 01 00 00 00 00 02 6C 08 
					29 01 00 00 00 00 02 6D 08 
					29 01 00 00 00 00 02 78 00 
					29 01 00 00 00 00 02 79 00 
					29 01 00 00 00 00 02 7E 00 
					29 01 00 00 00 00 02 7F 00 
					29 01 00 00 00 00 02 80 00 
					29 01 00 00 00 00 02 81 00 
					29 01 00 00 00 00 02 8D 00 
					29 01 00 00 00 00 02 8E 00 
					29 01 00 00 00 00 02 8F C0 
					29 01 00 00 00 00 02 90 73 
					29 01 00 00 00 00 02 91 10 
					29 01 00 00 00 00 02 92 09 
					29 01 00 00 00 00 02 96 11 
					29 01 00 00 00 00 02 97 14 
					29 01 00 00 00 00 02 98 00 
					29 01 00 00 00 00 02 99 00 
					29 01 00 00 00 00 02 9A 00 
					29 01 00 00 00 00 02 9B 61 
					29 01 00 00 00 00 02 9C 15 
					29 01 00 00 00 00 02 9D 30 
					29 01 00 00 00 00 02 9F 0F 
					29 01 00 00 00 00 02 A2 B0 
					29 01 00 00 00 00 02 A7 0A 
					29 01 00 00 00 00 02 A9 00 
					29 01 00 00 00 00 02 AA 70 
					29 01 00 00 00 00 02 AB DA 
					29 01 00 00 00 00 02 AC FF 
					29 01 00 00 00 00 02 AE F4 
					29 01 00 00 00 00 02 AF 40 
					29 01 00 00 00 00 02 B0 7F 
					29 01 00 00 00 00 02 B1 16 
					29 01 00 00 00 00 02 B2 53 
					29 01 00 00 00 00 02 B3 00 
					29 01 00 00 00 00 02 B4 2A 
					29 01 00 00 00 00 02 B5 3A 
					29 01 00 00 00 00 02 B6 F0 
					29 01 00 00 00 00 02 BC 85 
					29 01 00 00 00 00 02 BD F8 
					29 01 00 00 00 00 02 BE 3B 
					29 01 00 00 00 00 02 BF 13 
					29 01 00 00 00 00 02 C0 77 
					29 01 00 00 00 00 02 C1 77 
					29 01 00 00 00 00 02 C2 77 
					29 01 00 00 00 00 02 C3 77 
					29 01 00 00 00 00 02 C4 77 
					29 01 00 00 00 00 02 C5 77 
					29 01 00 00 00 00 02 C6 77 
					29 01 00 00 00 00 02 C7 77 
					29 01 00 00 00 00 02 C8 AA 
					29 01 00 00 00 00 02 C9 2A 
					29 01 00 00 00 00 02 CA 00 
					29 01 00 00 00 00 02 CB AA 
					29 01 00 00 00 00 02 CC 92 
					29 01 00 00 00 00 02 CD 00 
					29 01 00 00 00 00 02 CE 18 
					29 01 00 00 00 00 02 CF 88 
					29 01 00 00 00 00 02 D0 AA 
					29 01 00 00 00 00 02 D1 00 
					29 01 00 00 00 00 02 D2 00 
					29 01 00 00 00 00 02 D3 00 
					29 01 00 00 00 00 02 D6 02 
					29 01 00 00 00 00 02 ED 00 
					29 01 00 00 00 00 02 EE 00 
					29 01 00 00 00 00 02 EF 70 
					29 01 00 00 00 00 02 FA 03 
					29 01 00 00 00 00 02 FF 01                  
					29 01 00 00 00 00 02 FB 01                  
					29 01 00 00 00 00 02 75 00                  
					29 01 00 00 00 00 02 76 00                  
					29 01 00 00 00 00 02 77 00                  
					29 01 00 00 00 00 02 78 1D                  
					29 01 00 00 00 00 02 79 00                  
					29 01 00 00 00 00 02 7A 43                  
					29 01 00 00 00 00 02 7B 00                  
					29 01 00 00 00 00 02 7C 5F                  
					29 01 00 00 00 00 02 7D 00                  
					29 01 00 00 00 00 02 7E 76                  
					29 01 00 00 00 00 02 7F 00                  
					29 01 00 00 00 00 02 80 8A                  
					29 01 00 00 00 00 02 81 00                  
					29 01 00 00 00 00 02 82 9C                  
					29 01 00 00 00 00 02 83 00                  
					29 01 00 00 00 00 02 84 AC                  
					29 01 00 00 00 00 02 85 00                  
					29 01 00 00 00 00 02 86 BB                  
					29 01 00 00 00 00 02 87 00                  
					29 01 00 00 00 00 02 88 EC                  
					29 01 00 00 00 00 02 89 01                  
					29 01 00 00 00 00 02 8A 13                  
					29 01 00 00 00 00 02 8B 01                  
					29 01 00 00 00 00 02 8C 51                  
					29 01 00 00 00 00 02 8D 01                  
					29 01 00 00 00 00 02 8E 82                  
					29 01 00 00 00 00 02 8F 01                  
					29 01 00 00 00 00 02 90 CE                  
					29 01 00 00 00 00 02 91 02                  
					29 01 00 00 00 00 02 92 09                  
					29 01 00 00 00 00 02 93 02                  
					29 01 00 00 00 00 02 94 0B                  
					29 01 00 00 00 00 02 95 02                  
					29 01 00 00 00 00 02 96 41                  
					29 01 00 00 00 00 02 97 02                  
					29 01 00 00 00 00 02 98 7A                  
					29 01 00 00 00 00 02 99 02                  
					29 01 00 00 00 00 02 9A 9F                  
					29 01 00 00 00 00 02 9B 02                  
					29 01 00 00 00 00 02 9C D2                  
					29 01 00 00 00 00 02 9D 02                  
					29 01 00 00 00 00 02 9E F2                  
					29 01 00 00 00 00 02 9F 03                  
					29 01 00 00 00 00 02 A0 22                  
					29 01 00 00 00 00 02 A2 03                  
					29 01 00 00 00 00 02 A3 30                  
					29 01 00 00 00 00 02 A4 03                  
					29 01 00 00 00 00 02 A5 3F                  
					29 01 00 00 00 00 02 A6 03                  
					29 01 00 00 00 00 02 A7 50                  
					29 01 00 00 00 00 02 A9 03                  
					29 01 00 00 00 00 02 AA 63                  
					29 01 00 00 00 00 02 AB 03                  
					29 01 00 00 00 00 02 AC 79                  
					29 01 00 00 00 00 02 AD 03                  
					29 01 00 00 00 00 02 AE 97                  
					29 01 00 00 00 00 02 AF 03                  
					29 01 00 00 00 00 02 B0 C2                  
					29 01 00 00 00 00 02 B1 03                  
					29 01 00 00 00 00 02 B2 CD                  
					29 01 00 00 00 00 02 B3 00                  
					29 01 00 00 00 00 02 B4 00                  
					29 01 00 00 00 00 02 B5 00                  
					29 01 00 00 00 00 02 B6 1D                  
					29 01 00 00 00 00 02 B7 00                  
					29 01 00 00 00 00 02 B8 43                  
					29 01 00 00 00 00 02 B9 00                  
					29 01 00 00 00 00 02 BA 5F                  
					29 01 00 00 00 00 02 BB 00                  
					29 01 00 00 00 00 02 BC 76                  
					29 01 00 00 00 00 02 BD 00                  
					29 01 00 00 00 00 02 BE 8A                  
					29 01 00 00 00 00 02 BF 00                  
					29 01 00 00 00 00 02 C0 9C                  
					29 01 00 00 00 00 02 C1 00                  
					29 01 00 00 00 00 02 C2 AC                  
					29 01 00 00 00 00 02 C3 00                  
					29 01 00 00 00 00 02 C4 BB                  
					29 01 00 00 00 00 02 C5 00                  
					29 01 00 00 00 00 02 C6 EC                  
					29 01 00 00 00 00 02 C7 01                  
					29 01 00 00 00 00 02 C8 13                  
					29 01 00 00 00 00 02 C9 01                  
					29 01 00 00 00 00 02 CA 51                  
					29 01 00 00 00 00 02 CB 01                  
					29 01 00 00 00 00 02 CC 82                  
					29 01 00 00 00 00 02 CD 01                  
					29 01 00 00 00 00 02 CE CE                  
					29 01 00 00 00 00 02 CF 02                  
					29 01 00 00 00 00 02 D0 09                  
					29 01 00 00 00 00 02 D1 02                  
					29 01 00 00 00 00 02 D2 0B                  
					29 01 00 00 00 00 02 D3 02                  
					29 01 00 00 00 00 02 D4 41                  
					29 01 00 00 00 00 02 D5 02                  
					29 01 00 00 00 00 02 D6 7A                  
					29 01 00 00 00 00 02 D7 02                  
					29 01 00 00 00 00 02 D8 9F                  
					29 01 00 00 00 00 02 D9 02                  
					29 01 00 00 00 00 02 DA D2                  
					29 01 00 00 00 00 02 DB 02                  
					29 01 00 00 00 00 02 DC F2                  
					29 01 00 00 00 00 02 DD 03                  
					29 01 00 00 00 00 02 DE 22                  
					29 01 00 00 00 00 02 DF 03                  
					29 01 00 00 00 00 02 E0 30                  
					29 01 00 00 00 00 02 E1 03                  
					29 01 00 00 00 00 02 E2 3F                  
					29 01 00 00 00 00 02 E3 03                  
					29 01 00 00 00 00 02 E4 50                  
					29 01 00 00 00 00 02 E5 03                  
					29 01 00 00 00 00 02 E6 63                  
					29 01 00 00 00 00 02 E7 03                  
					29 01 00 00 00 00 02 E8 79                  
					29 01 00 00 00 00 02 E9 03                  
					29 01 00 00 00 00 02 EA 97                  
					29 01 00 00 00 00 02 EB 03                  
					29 01 00 00 00 00 02 EC C2                  
					29 01 00 00 00 00 02 ED 03                  
					29 01 00 00 00 00 02 EE CD                  
					29 01 00 00 00 00 02 EF 00                  
					29 01 00 00 00 00 02 F0 00                  
					29 01 00 00 00 00 02 F1 00                  
					29 01 00 00 00 00 02 F2 1D                  
					29 01 00 00 00 00 02 F3 00                  
					29 01 00 00 00 00 02 F4 43                  
					29 01 00 00 00 00 02 F5 00                  
					29 01 00 00 00 00 02 F6 5F                  
					29 01 00 00 00 00 02 F7 00                  
					29 01 00 00 00 00 02 F8 76                  
					29 01 00 00 00 00 02 F9 00                  
					29 01 00 00 00 00 02 FA 8A                  
					29 01 00 00 00 00 02 FF 02                  
					29 01 00 00 00 00 02 FB 01                  
					29 01 00 00 00 00 02 00 00                  
					29 01 00 00 00 00 02 01 9C                  
					29 01 00 00 00 00 02 02 00                  
					29 01 00 00 00 00 02 03 AC                  
					29 01 00 00 00 00 02 04 00                  
					29 01 00 00 00 00 02 05 BB                  
					29 01 00 00 00 00 02 06 00                  
					29 01 00 00 00 00 02 07 EC                  
					29 01 00 00 00 00 02 08 01                  
					29 01 00 00 00 00 02 09 13                  
					29 01 00 00 00 00 02 0A 01                  
					29 01 00 00 00 00 02 0B 51                  
					29 01 00 00 00 00 02 0C 01                  
					29 01 00 00 00 00 02 0D 82                  
					29 01 00 00 00 00 02 0E 01                  
					29 01 00 00 00 00 02 0F CE                  
					29 01 00 00 00 00 02 10 02                  
					29 01 00 00 00 00 02 11 09                  
					29 01 00 00 00 00 02 12 02                  
					29 01 00 00 00 00 02 13 0B                  
					29 01 00 00 00 00 02 14 02                  
					29 01 00 00 00 00 02 15 41                  
					29 01 00 00 00 00 02 16 02                  
					29 01 00 00 00 00 02 17 7A                  
					29 01 00 00 00 00 02 18 02                  
					29 01 00 00 00 00 02 19 9F                  
					29 01 00 00 00 00 02 1A 02                  
					29 01 00 00 00 00 02 1B D2                  
					29 01 00 00 00 00 02 1C 02                  
					29 01 00 00 00 00 02 1D F2                  
					29 01 00 00 00 00 02 1E 03                  
					29 01 00 00 00 00 02 1F 22                  
					29 01 00 00 00 00 02 20 03                  
					29 01 00 00 00 00 02 21 30                  
					29 01 00 00 00 00 02 22 03                  
					29 01 00 00 00 00 02 23 3F                  
					29 01 00 00 00 00 02 24 03                  
					29 01 00 00 00 00 02 25 50                  
					29 01 00 00 00 00 02 26 03                  
					29 01 00 00 00 00 02 27 63                  
					29 01 00 00 00 00 02 28 03                  
					29 01 00 00 00 00 02 29 79                  
					29 01 00 00 00 00 02 2A 03                  
					29 01 00 00 00 00 02 2B 97                  
					29 01 00 00 00 00 02 2D 03                  
					29 01 00 00 00 00 02 2F C2                  
					29 01 00 00 00 00 02 30 03                  
					29 01 00 00 00 00 02 31 CD                  
					29 01 00 00 00 00 02 32 00                  
					29 01 00 00 00 00 02 33 00                  
					29 01 00 00 00 00 02 34 00                  
					29 01 00 00 00 00 02 35 1D                  
					29 01 00 00 00 00 02 36 00                  
					29 01 00 00 00 00 02 37 43                  
					29 01 00 00 00 00 02 38 00                  
					29 01 00 00 00 00 02 39 5F                  
					29 01 00 00 00 00 02 3A 00                  
					29 01 00 00 00 00 02 3B 76                  
					29 01 00 00 00 00 02 3D 00                  
					29 01 00 00 00 00 02 3F 8A                  
					29 01 00 00 00 00 02 40 00                  
					29 01 00 00 00 00 02 41 9C                  
					29 01 00 00 00 00 02 42 00                  
					29 01 00 00 00 00 02 43 AC                  
					29 01 00 00 00 00 02 44 00                  
					29 01 00 00 00 00 02 45 BB                  
					29 01 00 00 00 00 02 46 00                  
					29 01 00 00 00 00 02 47 EC                  
					29 01 00 00 00 00 02 48 01                  
					29 01 00 00 00 00 02 49 13                  
					29 01 00 00 00 00 02 4A 01                  
					29 01 00 00 00 00 02 4B 51                  
					29 01 00 00 00 00 02 4C 01                  
					29 01 00 00 00 00 02 4D 82                  
					29 01 00 00 00 00 02 4E 01                  
					29 01 00 00 00 00 02 4F CE                  
					29 01 00 00 00 00 02 50 02                  
					29 01 00 00 00 00 02 51 09                  
					29 01 00 00 00 00 02 52 02                  
					29 01 00 00 00 00 02 53 0B                  
					29 01 00 00 00 00 02 54 02                  
					29 01 00 00 00 00 02 55 41                  
					29 01 00 00 00 00 02 56 02                  
					29 01 00 00 00 00 02 58 7A                  
					29 01 00 00 00 00 02 59 02                  
					29 01 00 00 00 00 02 5A 9F                  
					29 01 00 00 00 00 02 5B 02                  
					29 01 00 00 00 00 02 5C D2                  
					29 01 00 00 00 00 02 5D 02                  
					29 01 00 00 00 00 02 5E F2                  
					29 01 00 00 00 00 02 5F 03                  
					29 01 00 00 00 00 02 60 22                  
					29 01 00 00 00 00 02 61 03                  
					29 01 00 00 00 00 02 62 30                  
					29 01 00 00 00 00 02 63 03                  
					29 01 00 00 00 00 02 64 3F                  
					29 01 00 00 00 00 02 65 03                  
					29 01 00 00 00 00 02 66 50                  
					29 01 00 00 00 00 02 67 03                  
					29 01 00 00 00 00 02 68 63                  
					29 01 00 00 00 00 02 69 03                  
					29 01 00 00 00 00 02 6A 79                  
					29 01 00 00 00 00 02 6B 03                  
					29 01 00 00 00 00 02 6C 97                  
					29 01 00 00 00 00 02 6D 03                  
					29 01 00 00 00 00 02 6E C2                  
					29 01 00 00 00 00 02 6F 03                  
					29 01 00 00 00 00 02 70 CD                  
					29 01 00 00 00 00 02 71 00                  
					29 01 00 00 00 00 02 72 00                  
					29 01 00 00 00 00 02 73 00                  
					29 01 00 00 00 00 02 74 1D                  
					29 01 00 00 00 00 02 75 00                  
					29 01 00 00 00 00 02 76 43                  
					29 01 00 00 00 00 02 77 00                  
					29 01 00 00 00 00 02 78 5F                  
					29 01 00 00 00 00 02 79 00                  
					29 01 00 00 00 00 02 7A 76                  
					29 01 00 00 00 00 02 7B 00                  
					29 01 00 00 00 00 02 7C 8A                  
					29 01 00 00 00 00 02 7D 00                  
					29 01 00 00 00 00 02 7E 9C                  
					29 01 00 00 00 00 02 7F 00                  
					29 01 00 00 00 00 02 80 AC                  
					29 01 00 00 00 00 02 81 00                  
					29 01 00 00 00 00 02 82 BB                  
					29 01 00 00 00 00 02 83 00                  
					29 01 00 00 00 00 02 84 EC                  
					29 01 00 00 00 00 02 85 01                  
					29 01 00 00 00 00 02 86 13                  
					29 01 00 00 00 00 02 87 01                  
					29 01 00 00 00 00 02 88 51                  
					29 01 00 00 00 00 02 89 01                  
					29 01 00 00 00 00 02 8A 82                  
					29 01 00 00 00 00 02 8B 01                  
					29 01 00 00 00 00 02 8C CE                  
					29 01 00 00 00 00 02 8D 02                  
					29 01 00 00 00 00 02 8E 09                  
					29 01 00 00 00 00 02 8F 02                  
					29 01 00 00 00 00 02 90 0B                  
					29 01 00 00 00 00 02 91 02                  
					29 01 00 00 00 00 02 92 41                  
					29 01 00 00 00 00 02 93 02                  
					29 01 00 00 00 00 02 94 7A                  
					29 01 00 00 00 00 02 95 02                  
					29 01 00 00 00 00 02 96 9F                  
					29 01 00 00 00 00 02 97 02                  
					29 01 00 00 00 00 02 98 D2                  
					29 01 00 00 00 00 02 99 02                  
					29 01 00 00 00 00 02 9A F2                  
					29 01 00 00 00 00 02 9B 03                  
					29 01 00 00 00 00 02 9C 22                  
					29 01 00 00 00 00 02 9D 03                  
					29 01 00 00 00 00 02 9E 30                  
					29 01 00 00 00 00 02 9F 03                  
					29 01 00 00 00 00 02 A0 3F                  
					29 01 00 00 00 00 02 A2 03                  
					29 01 00 00 00 00 02 A3 50                  
					29 01 00 00 00 00 02 A4 03                  
					29 01 00 00 00 00 02 A5 63                  
					29 01 00 00 00 00 02 A6 03                  
					29 01 00 00 00 00 02 A7 79                  
					29 01 00 00 00 00 02 A9 03                  
					29 01 00 00 00 00 02 AA 97                  
					29 01 00 00 00 00 02 AB 03                  
					29 01 00 00 00 00 02 AC C2                  
					29 01 00 00 00 00 02 AD 03                  
					29 01 00 00 00 00 02 AE CD                                                                    
					29 01 00 00 00 00 02 AF 00                  
					29 01 00 00 00 00 02 B0 00                  
					29 01 00 00 00 00 02 B1 00                  
					29 01 00 00 00 00 02 B2 1D                  
					29 01 00 00 00 00 02 B3 00                  
					29 01 00 00 00 00 02 B4 43                  
					29 01 00 00 00 00 02 B5 00                  
					29 01 00 00 00 00 02 B6 5F                  
					29 01 00 00 00 00 02 B7 00                  
					29 01 00 00 00 00 02 B8 76                  
					29 01 00 00 00 00 02 B9 00                  
					29 01 00 00 00 00 02 BA 8A                  
					29 01 00 00 00 00 02 BB 00                  
					29 01 00 00 00 00 02 BC 9C                  
					29 01 00 00 00 00 02 BD 00                  
					29 01 00 00 00 00 02 BE AC                  
					29 01 00 00 00 00 02 BF 00                  
					29 01 00 00 00 00 02 C0 BB                  
					29 01 00 00 00 00 02 C1 00                  
					29 01 00 00 00 00 02 C2 EC                  
					29 01 00 00 00 00 02 C3 01                  
					29 01 00 00 00 00 02 C4 13                  
					29 01 00 00 00 00 02 C5 01                  
					29 01 00 00 00 00 02 C6 51                  
					29 01 00 00 00 00 02 C7 01                  
					29 01 00 00 00 00 02 C8 82                  
					29 01 00 00 00 00 02 C9 01                  
					29 01 00 00 00 00 02 CA CE                  
					29 01 00 00 00 00 02 CB 02                  
					29 01 00 00 00 00 02 CC 09                  
					29 01 00 00 00 00 02 CD 02                  
					29 01 00 00 00 00 02 CE 0B                  
					29 01 00 00 00 00 02 CF 02                  
					29 01 00 00 00 00 02 D0 41                  
					29 01 00 00 00 00 02 D1 02                  
					29 01 00 00 00 00 02 D2 7A                  
					29 01 00 00 00 00 02 D3 02                  
					29 01 00 00 00 00 02 D4 9F                  
					29 01 00 00 00 00 02 D5 02                  
					29 01 00 00 00 00 02 D6 D2                  
					29 01 00 00 00 00 02 D7 02                  
					29 01 00 00 00 00 02 D8 F2                  
					29 01 00 00 00 00 02 D9 03                  
					29 01 00 00 00 00 02 DA 22                  
					29 01 00 00 00 00 02 DB 03                  
					29 01 00 00 00 00 02 DC 30                  
					29 01 00 00 00 00 02 DD 03                  
					29 01 00 00 00 00 02 DE 3F                  
					29 01 00 00 00 00 02 DF 03                  
					29 01 00 00 00 00 02 E0 50                  
					29 01 00 00 00 00 02 E1 03                  
					29 01 00 00 00 00 02 E2 63                  
					29 01 00 00 00 00 02 E3 03                  
					29 01 00 00 00 00 02 E4 79                  
					29 01 00 00 00 00 02 E5 03                  
					29 01 00 00 00 00 02 E6 97                  
					29 01 00 00 00 00 02 E7 03                  
					29 01 00 00 00 00 02 E8 C2                  
					29 01 00 00 00 00 02 E9 03                  
					29 01 00 00 00 00 02 EA CD                  
					29 01 00 00 00 00 02 FF 00 
					05 01 00 00 96 00 02 11 00
					05 01 00 00 32 00 02 29 00];
		qcom,mdss-dsi-off-command = [05 01 00 00 32 00 02 28 00
					05 01 00 00 96 00 02 10 00];
		qcom,mdss-dsi-on-command-state = "dsi_lp_mode";
		qcom,mdss-dsi-off-command-state = "dsi_hs_mode";
		qcom,mdss-dsi-h-sync-pulse = <1>;
		qcom,mdss-dsi-traffic-mode = "burst_mode";
		qcom,mdss-dsi-lane-map = "lane_map_0123";
		qcom,mdss-dsi-bllp-eof-power-mode;
		qcom,mdss-dsi-bllp-power-mode;
		qcom,mdss-dsi-lane-0-state;
		qcom,mdss-dsi-lane-1-state;
		qcom,mdss-dsi-lane-2-state;
		qcom,mdss-dsi-lane-3-state;
		qcom,mdss-dsi-panel-timings = [f9 3d 34 00 58 4d 36 3f 53 03 04 00];
		qcom,mdss-dsi-t-clk-post = <0x1e>;
		qcom,mdss-dsi-t-clk-pre = <0x38>;
		qcom,mdss-dsi-bl-min-level = <1>;
		qcom,mdss-dsi-bl-max-level = <255>;
		qcom,mdss-dsi-dma-trigger = "trigger_sw";
		qcom,mdss-dsi-mdp-trigger = "none";
		qcom,mdss-dsi-bl-pmic-control-type = "bl_ctrl_pwm";
		qcom,mdss-dsi-panel-orientation = "180";
		qcom,mdss-dsi-reset-sequence = <1 20>, <0 2>, <1 20>;
	};
};
